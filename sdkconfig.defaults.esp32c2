## sdkconfig.defaults.esp32c2
```kconfig
CONFIG_ESPTOOLPY_FLASHSIZE_4MB=y

CONFIG_PARTITION_TABLE_CUSTOM=y
CONFIG_PARTITION_TABLE_CUSTOM_FILENAME="partitions_4M.csv"
CONFIG_PARTITION_TABLE_FILENAME="partitions_4M.csv"
CONFIG_PARTITION_TABLE_OFFSET=0x8000

CONFIG_FREERTOS_HZ=1000

CONFIG_FREERTOS_IDLE_TASK_STACKSIZE=768
CONFIG_FREERTOS_TIMER_TASK_STACK_DEPTH=1536
CONFIG_SYSTEM_EVENT_TASK_STACK_SIZE=2560
CONFIG_IPC_TASK_STACK_SIZE=1024
CONFIG_TIMER_TASK_STACK_SIZE=2048
CONFIG_XTAL_FREQ_26=y

CONFIG_COMPILER_OPTIMIZATION_SIZE=y

CONFIG_UART_ISR_IN_IRAM=y

CONFIG_ESP_MAIN_TASK_STACK_SIZE=4096

CONFIG_MBEDTLS_SSL_VARIABLE_BUFFER_LENGTH=y
CONFIG_MBEDTLS_SSL_KEEP_PEER_CERTIFICATE=y
CONFIG_MBEDTLS_DYNAMIC_BUFFER=y
CONFIG_MBEDTLS_DYNAMIC_FREE_CONFIG_DATA=y
CONFIG_MBEDTLS_DYNAMIC_FREE_CA_CERT=y

CONFIG_ESP_WIFI_STATIC_RX_BUFFER_NUM=6

CONFIG_ESP_WIFI_DYNAMIC_TX_BUFFER_NUM=18
CONFIG_LWIP_IPV6=n
CONFIG_LWIP_TCP_ACCEPTMBOX_SIZE=3
CONFIG_LWIP_MAX_SOCKETS=3


CONFIG_LWIP_TCP_OVERSIZE_QUARTER_MSS=y
CONFIG_LWIP_TCP_SND_BUF_DEFAULT=4320
CONFIG_LWIP_TCP_WND_DEFAULT=4320
CONFIG_PTHREAD_TASK_STACK_SIZE_DEFAULT=2048
CONFIG_TCPIP_TASK_STACK_SIZE=2048
CONFIG_LWIP_TCPIP_RECVMBOX_SIZE=16
```
